## idf/Kconfig.projbuild
```kconfig
menu "CoStar DSL Runtime"

config COSTAR_DSL_TLS_MIN_LARGEST_8BIT_KB
    int "TLS guard minimum largest free block (KB)"
    range 16 64
    default 20
    help
        Minimum required largest contiguous MALLOC_CAP_8BIT block for new
        TLS handshakes in DSL HTTP/WS flows.

config COSTAR_DSL_TLS_MIN_FREE_8BIT_KB
    int "TLS guard minimum free heap (KB)"
    range 24 192
    default 40
    help
        Minimum required total free heap for new TLS handshakes.

config COSTAR_DSL_TLS_RELAXED_LARGEST_8BIT_KB
    int "TLS guard relaxed largest free block (KB)"
    range 16 64
    default 19
    help
        Relaxed largest-block threshold used when total free heap is above
        the relaxed-free threshold.

config COSTAR_DSL_TLS_RELAXED_FREE_THRESHOLD_8BIT_KB
    int "TLS guard relaxed mode free heap threshold (KB)"
    range 32 256
    default 60
    help
        If total free heap is at least this threshold, the runtime uses the
        relaxed largest-block requirement above.

endmenu
```

## idf/sdkconfig.defaults
```kconfig
CONFIG_ESP_CONSOLE_UART_DEFAULT=y
CONFIG_ESP_CONSOLE_UART_BAUDRATE=115200
CONFIG_ESPTOOLPY_FLASHSIZE_4MB=y
CONFIG_PARTITION_TABLE_CUSTOM=y
CONFIG_PARTITION_TABLE_CUSTOM_FILENAME="partitions.csv"
CONFIG_ESP_MAIN_TASK_STACK_SIZE=12288
CONFIG_MAIN_TASK_STACK_SIZE=12288
# Release-size compiler profile for smaller stack/heap pressure from generated code.
CONFIG_COMPILER_OPTIMIZATION_SIZE=y
# Keep runtime logs at debug per request.
CONFIG_LOG_DEFAULT_LEVEL_DEBUG=y
# Trim optional mbedTLS text/self-test features to reduce static memory footprint.
CONFIG_MBEDTLS_ERROR_STRINGS=n
CONFIG_MBEDTLS_SELF_TEST=n
CONFIG_MBEDTLS_VERSION_C=n
# TimeSync.cpp registers two NTP servers (pool.ntp.org + time.nist.gov);
# default MAX_SERVERS=1 silently drops the second. Allow both.
CONFIG_LWIP_SNTP_MAX_SERVERS=2
CONFIG_LV_BUILD_EXAMPLES=n
CONFIG_LV_USE_DEMO_WIDGETS=n
CONFIG_LV_USE_DEMO_STRESS=n
CONFIG_LV_USE_DEMO_MUSIC=n
# Low-memory TLS profile for long-running DSL widget layouts.
CONFIG_MBEDTLS_ASYMMETRIC_CONTENT_LEN=y
CONFIG_MBEDTLS_SSL_PROTO_TLS1_3=y
CONFIG_MBEDTLS_SSL_IN_CONTENT_LEN=4096
CONFIG_MBEDTLS_SSL_OUT_CONTENT_LEN=2048
CONFIG_MBEDTLS_DYNAMIC_BUFFER=y
CONFIG_MBEDTLS_DYNAMIC_FREE_CONFIG_DATA=y
CONFIG_MBEDTLS_CERTIFICATE_BUNDLE_MAX_CERTS=512
CONFIG_MBEDTLS_CERTIFICATE_BUNDLE_CROSS_SIGNED_VERIFY=y
# Don't retain peer certs post-handshake; saves heap on long-lived TLS sockets.
CONFIG_MBEDTLS_SSL_KEEP_PEER_CERTIFICATE=n
# Prevent persistent TLS session state from shrinking largest-free-block after
# first HTTPS handshakes in long-running widget layouts.
CONFIG_MBEDTLS_CLIENT_SSL_SESSION_TICKETS=n
CONFIG_MBEDTLS_SERVER_SSL_SESSION_TICKETS=n
# Allow runtime opt-in insecure TLS for self-signed/private endpoints.
# Cert verification remains default unless DSL explicitly sets data.tls_skip_verify=true.
CONFIG_ESP_TLS_INSECURE=y
CONFIG_ESP_TLS_SKIP_SERVER_CERT_VERIFY=y
```
